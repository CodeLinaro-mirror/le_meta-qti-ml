## conf/layer.conf
```bitbake
BBFILES += "${LAYERDIR}/recipes/*/*.bb ${LAYERDIR}/recipes/*/*.bbappend ${LAYERDIR}/recipes-*/*/*.bb ${LAYERDIR}/recipes-*/*/*.bbappend"
BBPATH .= ":${LAYERDIR}"
BBFILE_COLLECTIONS += "ml"
BBFILE_PRIORITY_ml = "12"
BBFILE_PATTERN_ml := "^${LAYERDIR}/"

BASE_DEPENDS += "virtual/kernel system-core binder libhardware liblog libcutils glib-2.0"
BASE_EXTRAS_CMAKE += " -DTARGET_BOARD_PLATFORM=${BASEMACHINE} -DSYSROOT_INCDIR=${STAGING_INCDIR} -DSYSROOT_LIBDIR=${STAGING_LIBDIR} -DKERNEL_INCDIR=${STAGING_KERNEL_BUILDDIR}"
```
